## boards/arm/e73/Kconfig.board
```kconfig
# SPDX-License-Identifier: MIT
config BOARD_E73
    bool "Ebyte E73 Module"
    depends on SOC_NRF52840_QIAA
```

## boards/arm/e73/Kconfig.defconfig
```kconfig
# SPDX-License-Identifier: MIT
if BOARD_E73

config BOARD
    default "e73"

config BT_CTLR
    default BT

endif # BOARD_E73
```

## boards/arm/e73/e73_defconfig
```kconfig
# SPDX-License-Identifier: MIT
CONFIG_SOC_SERIES_NRF52X=y
CONFIG_SOC_NRF52840_QIAA=y
CONFIG_ARM_MPU=y
CONFIG_BOARD_E73=y

CONFIG_GPIO=y

# 32kHz clock source
CONFIG_CLOCK_CONTROL_NRF_K32SRC_XTAL=y
CONFIG_CLOCK_CONTROL_NRF_K32SRC_50PPM=y

CONFIG_ZMK_USB=y
CONFIG_ZMK_BLE=y

CONFIG_USB_DEVICE_STACK=y
CONFIG_USB_DEVICE_PRODUCT="Ebyte E73 Module"
CONFIG_USB_DEVICE_VID=0x1d50
CONFIG_USB_DEVICE_PID=0x615e

CONFIG_SERIAL=y
CONFIG_UART_CONSOLE=y
CONFIG_CONSOLE=y

CONFIG_FLASH=y
CONFIG_FLASH_PAGE_LAYOUT=y
CONFIG_FLASH_MAP=y
CONFIG_NVS=y

CONFIG_ZMK_BATTERY_REPORTING=y
```

## boards/shields/arc/Kconfig.shield
```kconfig
config SHIELD_ARC_LEFT
    def_bool $(shields_list_contains,arc_left)

config SHIELD_ARC_RIGHT
    def_bool $(shields_list_contains,arc_right)
```
